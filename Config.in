## Config.in
```kconfig
menu "AegisPanel OS Packages"
    source "$BR2_EXTERNAL_AEGISPANEL_OS_PATH/packages/aegispanel-core/Config.in"
    source "$BR2_EXTERNAL_AEGISPANEL_OS_PATH/packages/aegispanel-ui/Config.in"
    source "$BR2_EXTERNAL_AEGISPANEL_OS_PATH/packages/aegispanel-updater/Config.in"
endmenu
```

## packages/aegispanel-core/Config.in
```kconfig
config BR2_PACKAGE_AEGISPANEL_CORE
	bool "aegispanel-core"
	depends on BR2_PACKAGE_HOST_RUSTC_ARCH_SUPPORTS
	select BR2_PACKAGE_HOST_RUSTC
	help
	  AegisPanel OS native Rust core daemon managing state machine,
	  HA WebSocket, GPIO, Power Management, and IPC.
```

## packages/aegispanel-ui/Config.in
```kconfig
config BR2_PACKAGE_AEGISPANEL_UI
	bool "aegispanel-ui"
	depends on BR2_PACKAGE_HAS_LIBEGL
	depends on BR2_PACKAGE_HAS_LIBGLES
	depends on BR2_INSTALL_LIBSTDCPP
	select BR2_PACKAGE_LIBWPE
	select BR2_PACKAGE_WPEBACKEND_FDO
	select BR2_PACKAGE_WPEWEBKIT
	select BR2_PACKAGE_COG
	select BR2_PACKAGE_COG_PLATFORM_FDO
	select BR2_PACKAGE_COG_PLATFORM_DRM
	help
	  Security Screen and First-Boot Wizard HTML5/TypeScript web applications
	  rendered via WPE WebKit and Cog launcher over DRM/KMS / Wayland FDO.
```

## packages/aegispanel-updater/Config.in
```kconfig
config BR2_PACKAGE_AEGISPANEL_UPDATER
	bool "aegispanel-updater"
	select BR2_PACKAGE_RAUC
	help
	  AegisPanel OS A/B atomic updater package.
```
